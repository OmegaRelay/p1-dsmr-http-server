## app/modules/dsmr_p1/Kconfig
```kconfig
menuconfig DSMR_P1
	bool "DSMR P1 Port Support"
    depends on SERIAL && GPIO
    select UART_INTERRUPT_DRIVEN
    select RING_BUFFER
	help
	  This option enables the Dutch-Smart-Meter-Requirement P1 Port library

if DSMR_P1

module = DSMR_P1
module-str = dsmr-p1
source "subsys/logging/Kconfig.template.log_config"

config DSMR_P1_BUF_SIZE
    int "DSMR P1 buffer size"
    default 4096
    help
        This option sets the size of the static message buffer of the DSMR P1 library

endif # DSMR_P1
```

## modules/dsmr_p1/Kconfig
```kconfig
menuconfig DSMR_P1
	bool "DSMR P1 Port Support"
    depends on SERIAL && GPIO
    select UART_INTERRUPT_DRIVEN
    select RING_BUFFER
    select FPU
	help
	  This option enables the Dutch-Smart-Meter-Requirement P1 Port library

if DSMR_P1

module = DSMR_P1
module-str = dsmr-p1
source "subsys/logging/Kconfig.template.log_config"

config DSMR_P1_BUF_SIZE
    int "DSMR P1 buffer size"
    default 4096
    help
        This option sets the size of the static message buffer of the DSMR P1 library

config DSMR_P1_THREAD_PRIORITY
    int "Priority of the DSMR P1 Thread"
    default 5

endif # DSMR_P1
```

## modules/sysbuild/Kconfig
```kconfig
config BUILD_OUTPUT_HEX
	bool "Build a binary in HEX format for each image"
	help
	  Build an Intel HEX binary zephyr/zephyr.hex in the build directory.
	  The name of this file can be customized with CONFIG_KERNEL_BIN_NAME.
```
